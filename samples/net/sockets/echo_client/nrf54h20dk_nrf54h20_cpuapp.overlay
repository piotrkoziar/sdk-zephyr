/*
 * Copyright (c) 2021 Nordic Semiconductor ASA
 *
 * SPDX-License-Identifier: Apache-2.0
 */

/ {
	chosen {
		zephyr,console = &uart136;
		zephyr,shell-uart = &uart136;
	};
};

&uart135 {
	status = "disabled";
};